hm: homerow_mods {
    compatible = "zmk,behavior-hold-tap";
    label = "HOMEROW_MODS";
    #binding-cells = <2>;
    tapping-term-ms = <120>;
    quick_tap_ms = <180>;
    flavor = "tap-preferred";
    bindings = <&kp>, <&kp>;
};

hm_spc: hm_spc {
    compatible = "zmk,behavior-hold-tap";
    label = "hm_spc";
    #binding-cells = <2>;
    tapping-term-ms = <200>;
    quick_tap_ms = <180>;
    flavor = "tap-preferred";
    bindings = <&kp>, <&kp>;
};

hm_bspc: hm_bspc {
    compatible = "zmk,behavior-hold-tap";
    label = "hm_bspc";
    #binding-cells = <2>;
    tapping-term-ms = <120>;
    quick_tap_ms = <180>;
    flavor = "hold-preferred";
    bindings = <&kp>, <&kp>;
    retro-tap;
};

hm_to: homerow_layer {
    compatible = "zmk,behavior-hold-tap";
    label = "HOMEROW_LAYER";
    #binding-cells = <2>;
    tapping-term-ms = <200>;
    quick_tap_ms = <180>;
    flavor = "tap-preferred";
    bindings = <&mo>, <&kp>;
};

kp_tog: kp_tog {
    compatible = "zmk,behavior-hold-tap";
    label = "KP_TOG";
    #binding-cells = <2>;
    tapping-term-ms = <135>;
    quick_tap_ms = <0>;
    flavor = "tap-preferred";
    bindings = <&kp>, <&tog>;
};

kp_to: kp_to {
    compatible = "zmk,behavior-hold-tap";
    label = "KP_TO";
    #binding-cells = <2>;
    tapping-term-ms = <135>;
    quick_tap_ms = <0>;
    flavor = "tap-preferred";
    bindings = <&kp>, <&to>;
};

mo_to: mo_to {
    compatible = "zmk,behavior-hold-tap";
    label = "MO_TO";
    #binding-cells = <2>;
    tapping-term-ms = <135>;
    quick_tap_ms = <0>;
    flavor = "tap-preferred";
    bindings = <&mo>, <&to>;
};


hm: homerow_mods {
    compatible = "zmk,behavior-hold-tap";
    label = "HOMEROW_MODS";
    #binding-cells = <2>;
    tapping-term-ms = <120>;
    quick_tap_ms = <180>;
    flavor = "tap-preferred";
    bindings = <&kp>, <&kp>;
};


#define HOME_ROW_MACRO(macro) \
    hm_##macro: hm_##macro { \
        compatible = "zmk,behavior-hold-tap"; \
        label = ZMK_MACRO_STRINGIFY(hm_##macro); \
        #binding-cells = <2>; \
        tapping-term-ms = <120>; \
        quick_tap_ms = <180>; \
        flavor = "tap-preferred"; \
        bindings = <&kp>, <&macro>; \
    };

HOME_ROW_MACRO(sym_LBKT)
HOME_ROW_MACRO(letter_X)


#define DOUBLE_KEY(name, key) \
    ZMK_MACRO( \
        double_macro_##name, \
        wait-ms = <0>; \
        tap-ms = <0>; \
        bindings \
            = <&macro_tap &kp key> \
            , <&macro_pause_for_release> \
           ; \
    ) \
    double_key_##name: double_key_##name { \
        compatible = "zmk,behavior-hold-tap"; \
        label = ZMK_MACRO_STRINGIFY(double_key_##name); \
        #binding-cells = <2>; \
        tapping-term-ms = <180>; \
        flavor = "tap-preferred"; \
        bindings = <&double_macro_##name>, <&kp>; \
    };

