
#define HOME_ROW_MACRO(macro) \
    hm_##macro: hm_##macro { \
        compatible = "zmk,behavior-hold-tap"; \
        label = STRINGIFY(hm_##macro); \
        #binding-cells = <2>; \
        tapping-term-ms = <120>; \
        quick-tap-ms = <180>; \
        flavor = "tap-preferred"; \
        bindings = <&kp>, <&macro>; \
    };

HOME_ROW_MACRO(sym_LBKT)


sym_num_app_spc2: sym_num_app_spc2 {
    compatible = "zmk,behavior-hold-tap";
    label = "sym_num_app_spc2";
    #binding-cells = <2>;
    tapping-term-ms = <120>;
    quick-tap-ms = <180>;
    flavor = "tap-preferred";
    bindings = <&num_app_alpha>, <&sym_SPC>;
};



#define DOUBLE_KEY(name, holdKey) \
    MACRO(double_macro_##name, \
          <&macro_tap &kp holdKey> \
        , <&macro_pause_for_release> \
    ) \
    double_key_##name: double_key_##name { \
        compatible = "zmk,behavior-hold-tap"; \
        label = STRINGIFY(double_key_##name); \
        #binding-cells = <2>; \
        tapping-term-ms = <180>; \
        flavor = "tap-preferred"; \
        bindings = <&double_macro_##name>, <&kp>; \
    };

#define DOUBLE_KEY_WITH_MACRO(name, pressMacro) \
    double_key_macro_##name: double_key_##name { \
        compatible = "zmk,behavior-hold-tap"; \
        label = STRINGIFY(double_key_##name); \
        #binding-cells = <2>; \
        tapping-term-ms = <180>; \
        flavor = "tap-preferred"; \
        bindings = <&kp>, <&pressMacro>; \
    };

DOUBLE_KEY_WITH_MACRO(paste, paste_macro)


MACRO(sym_LBKT2,
      <&macro_tap &to SYMBOL>
    , <&macro_tap &tog ALPHA>
    , <&macro_release &kp LALT>
    , <&macro_press &kp LBKT>
    , <&macro_pause_for_release>
    , <&macro_release &kp LBKT>
)

hm_sym_LBKT2: hm_sym_LBKT2 {
    compatible = "zmk,behavior-hold-tap";
    label = "hm_sym_LBKT2";
    #binding-cells = <2>;
    tapping-term-ms = <120>;
    quick-tap-ms = <180>;
    flavor = "tap-preferred";
    bindings = <&kp>, <&sym_LBKT2>;
};



MACRO(sym_LBKT,
      <&macro_release &kp LALT>
    , <&macro_press &kp LBKT>
    , <&macro_pause_for_release>
    , <&macro_release &kp LBKT>
)
