
HT_QT("tap-preferred", hm, &kp, &kp, 120, 180)
HT_QT("tap-preferred", hm_spc, &kp, &kp, 200, 180)
HT_QT("tap-preferred", hm_to, &mo, &kp, 200, 180)
HT("tap-preferred", kp_to, &kp, &to, 135)

HT_QT("tap-preferred", hm_dot, &kp, &shifting_dot, 120, 180)
HT_QT("tap-preferred", hm_shifting_spc, &mo, &shifting_spc, 120, 180)


HT("tap-preferred", sht_num_app_spc, &num_app_layer, &space_cmd, 135)
MOD_MORPH(space_cmd, &kp SPC, &space_cmd_alpha, MOD_LGUI)
MACRO(space_cmd_alpha, <&to ALPHA &kp LG(SPC)>)

HT("tap-preferred", num_app_to, &num_app_layer, &to, 135)
MACRO(num_app_layer,
    <&macro_press &mo NUM_APP>,
    <&macro_pause_for_release>,
    <&macro_release &mo NUM_APP>
)


HT_QT("hold-preferred", sht_with_ctl_kp, &sht_with_ctl, &kp, 120, 180)
MACRO(sht_with_ctl,
    <&macro_press &mo SHORTCUT &kp LCTL>,
    <&macro_pause_for_release>,
    <&macro_release &mo SHORTCUT &kp LCTL>
)


HT_QT("hold-preferred", symbol_with_alt_kp, &symbol_with_alt, &kp, 120, 180)
MACRO(symbol_with_alt,
    <&macro_press &mo SYMBOL &kp LALT>,
    <&macro_pause_for_release>,
    <&macro_release &mo SYMBOL &kp LALT>
)


HT("tap-preferred", sht_with_gui_to, &sht_with_gui, &to, 135)
HT_QT("tap-preferred", sht_with_gui_kp, &sht_with_gui, &kp, 135, 180)
MACRO(sht_with_gui,
    <&macro_press &mo SHORTCUT &kp LGUI>,
    <&macro_pause_for_release>,
    <&macro_release &mo SHORTCUT &kp LGUI>
)



sl_ignore_mods_long: sl_ignore_mods_long {
    compatible = "zmk,behavior-sticky-key";
    label = "sl_ignore_mods_long";
    #binding-cells = <1>;
    release-after-ms = <60000>;
    bindings = <&mo>;
    ignore-modifiers;
    quick-release;
};

sl_ignore_mods_quick: sl_ignore_mods_quick {
    compatible = "zmk,behavior-sticky-key";
    label = "sl_ignore_mods_quick";
    #binding-cells = <1>;
    release-after-ms = <2000>;
    bindings = <&mo>;
    ignore-modifiers;
    quick-release;
};

