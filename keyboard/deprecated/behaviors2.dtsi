




sym_num_app_spc: sym_num_app_spc {
    compatible = "zmk,behavior-hold-tap";
    label = "sym_num_app_spc";
    #binding-cells = <2>;
    tapping-term-ms = <135>;
    quick-tap-ms = <0>;
    flavor = "tap-preferred";
    bindings = <&num_app_alpha>, <&sym_SPC>;
};








MACRO(holding_hm_shift_lbkt,
      <&to ALPHA>
    , <&macro_tap &to ALPHA>
    , <&macro_tap &tog SYMBOL>
    , <&macro_press &hold_hm_shift_lbkt 0 0>
    , <&macro_pause_for_release>
    , <&macro_release &hold_hm_shift_lbkt 0 0>
)

hold_hm_shift_lbkt: hold_hm_shift_lbkt {
    compatible = "zmk,behavior-hold-tap";
    label = "hold_hm_shift_lbkt";
    #binding-cells = <2>;
    tapping-term-ms = <180>;
    flavor = "tap-preferred";
    bindings = <&nav_hold_shift>, <&sym_LBKT>;
};

MACRO(nav_hold_shift,
      <&macro_press &kp LSFT>
    , <&macro_pause_for_release>
    , <&macro_release &kp LSFT>
    , <&macro_tap &to NAV>
    , <&macro_tap &kp A>
)


//    hm_##macro: hm_##macro {
//        compatible = "zmk,behavior-hold-tap";
//        label = STRINGIFY(hm_##macro);
//        #binding-cells = <2>;
//        tapping-term-ms = <120>;
//        quick-tap-ms = <180>;
//        flavor = "tap-preferred";
//        bindings = <&kp>, <&macro>;
//    };


MACRO(first_macro,
      <&macro_tap &kp A>
    , <&macro_press &hold_tap_macro 0 Z>
    , <&macro_pause_for_release>
    , <&macro_release &hold_tap_macro 0 Z>
    , <&macro_tap &kp B>
)

hold_tap_macro: hold_tap_macro {
    compatible = "zmk,behavior-hold-tap";
    label = "hold_tap_macro";
    #binding-cells = <2>;
    tapping-term-ms = <120>;
    quick-tap-ms = <180>;
    flavor = "tap-preferred";
    bindings = <&second_macro>, <&kp>;
};


MACRO(second_macro,
      <&macro_tap &kp C>
    , <&macro_pause_for_release>
    , <&macro_tap &kp D>
)
