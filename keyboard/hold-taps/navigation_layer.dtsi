







MACRO(space_cmd_alpha, <&to ALPHA &kp LG(SPC)>)


MACRO(paste_macro, <&kp _PASTE &sl PASTE_MO>)


sht_num_app_spc: sht_num_app_spc {
    compatible = "zmk,behavior-hold-tap";
    label = "sht_num_app_spc";
    #binding-cells = <2>;
    tapping-term-ms = <135>;
    quick-tap-ms = <0>;
    flavor = "tap-preferred";
    bindings = <&num_app_layer>, <&space_cmd>;
};


space_cmd: space_cmd {
   compatible = "zmk,behavior-mod-morph";
   label = "space_cmd";
   #binding-cells = <0>;
   bindings = <&kp SPC>, <&space_cmd_alpha>;
   mods = <(MOD_LGUI)>;
};


