
macro_hm_bspc: macro_hm_bspc {
    compatible = "zmk,behavior-hold-tap";
    label = "macro_hm_bspc";
    #binding-cells = <2>;
    tapping-term-ms = <120>;
    quick_tap_ms = <180>;
    flavor = "hold-preferred";
    bindings = <&symbol_layer_alt>, <&kp>;
};

nav_ctrl_ret: nav_ctrl_ret {
    compatible = "zmk,behavior-hold-tap";
    label = "nav_ctrl_ret";
    #binding-cells = <2>;
    tapping-term-ms = <120>;
    quick_tap_ms = <180>;
    flavor = "hold-preferred";
    bindings = <&nav_ctrl>, <&kp>;

};
num_app_to: num_app_to {
    compatible = "zmk,behavior-hold-tap";
    label = "num_app_to";
    #binding-cells = <2>;
    tapping-term-ms = <135>;
    quick_tap_ms = <0>;
    flavor = "tap-preferred";
    bindings = <&num_app_alpha>, <&to>;
};

sym_num_app_spc: sym_num_app_spc {
    compatible = "zmk,behavior-hold-tap";
    label = "sym_num_app_spc";
    #binding-cells = <2>;
    tapping-term-ms = <135>;
    quick_tap_ms = <0>;
    flavor = "tap-preferred";
    bindings = <&num_app_alpha>, <&sym_SPC>;
};

sht_num_app_spc: sht_num_app_spc {
    compatible = "zmk,behavior-hold-tap";
    label = "sht_num_app_spc";
    #binding-cells = <2>;
    tapping-term-ms = <135>;
    quick_tap_ms = <0>;
    flavor = "tap-preferred";
    bindings = <&num_app_alpha>, <&space_cmd>;
};

space_cmd: space_cmd {
   compatible = "zmk,behavior-mod-morph";
   label = "space_cmd";
   #binding-cells = <0>;
   bindings = <&kp SPC>, <&space_cmd_alpha>;
   mods = <(MOD_LGUI)>;
};

MACRO(space_cmd_alpha, <&to ALPHA &kp LG(SPC)>)


MACRO(paste_macro, <&kp _PASTE &sl PASTE_MO>)

MACRO(nav_gui,
      <&macro_press &mo SHORTCUT &kp LGUI>
    , <&macro_pause_for_release>
    , <&macro_release &mo SHORTCUT &kp LGUI>
)

MACRO(nav_ctrl,
      <&macro_press &mo SHORTCUT &kp LCTL>
    , <&macro_pause_for_release>
    , <&macro_release &mo SHORTCUT &kp LCTL>
)

MACRO(num_app_alpha,
      <&macro_tap &tog NUM_APP>
    , <&macro_pause_for_release>
    , <&macro_tap &tog NUM_APP>
)

MACRO(symbol_layer_alt,
      <&macro_press &mo SYMBOL &kp LALT>
    , <&macro_pause_for_release>
    , <&macro_release &mo SYMBOL &kp LALT>
)


MACRO(holding_hm_shift_lbkt,
      <&to ALPHA>
    , <&macro_tap &to ALPHA>
    , <&macro_tap &tog SYMBOL>
    , <&macro_press &hold_hm_shift_lbkt 0 0>
    , <&macro_pause_for_release>
    , <&macro_release &hold_hm_shift_lbkt 0 0>
)

hold_hm_shift_lbkt: hold_hm_shift_lbkt {
    compatible = "zmk,behavior-hold-tap";
    label = "hold_hm_shift_lbkt";
    #binding-cells = <2>;
    tapping-term-ms = <180>;
    flavor = "tap-preferred";
    bindings = <&nav_hold_shift>, <&sym_LBKT>;
};

MACRO(nav_hold_shift,
      <&macro_press &kp LSFT>
    , <&macro_pause_for_release>
    , <&macro_release &kp LSFT>
    , <&macro_tap &to NAV>
    , <&macro_tap &kp A>
)

MACRO(sym_LBKT,
      <&macro_release &kp LALT>
    , <&macro_press &kp LBKT>
    , <&macro_pause_for_release>
    , <&macro_release &kp LBKT>
)
//    hm_##macro: hm_##macro {
//        compatible = "zmk,behavior-hold-tap";
//        label = STRINGIFY(hm_##macro);
//        #binding-cells = <2>;
//        tapping-term-ms = <120>;
//        quick_tap_ms = <180>;
//        flavor = "tap-preferred";
//        bindings = <&kp>, <&macro>;
//    };

MACRO(sym_LBKT2,
      <&macro_tap &to SYMBOL>
    , <&macro_tap &tog ALPHA>
    , <&macro_release &kp LALT>
    , <&macro_press &kp LBKT>
    , <&macro_pause_for_release>
    , <&macro_release &kp LBKT>
)

hm_sym_LBKT2: hm_sym_LBKT2 {
    compatible = "zmk,behavior-hold-tap";
    label = "hm_sym_LBKT2";
    #binding-cells = <2>;
    tapping-term-ms = <120>;
    quick_tap_ms = <180>;
    flavor = "tap-preferred";
    bindings = <&kp>, <&sym_LBKT2>;
};

MACRO(first_macro,
      <&macro_tap &kp A>
    , <&macro_press &hold_tap_macro 0 Z>
    , <&macro_pause_for_release>
    , <&macro_release &hold_tap_macro 0 Z>
    , <&macro_tap &kp B>
)

hold_tap_macro: hold_tap_macro {
    compatible = "zmk,behavior-hold-tap";
    label = "hold_tap_macro";
    #binding-cells = <2>;
    tapping-term-ms = <120>;
    quick_tap_ms = <180>;
    flavor = "tap-preferred";
    bindings = <&second_macro>, <&kp>;
};


MACRO(second_macro,
      <&macro_tap &kp C>
    , <&macro_pause_for_release>
    , <&macro_tap &kp D>
)
